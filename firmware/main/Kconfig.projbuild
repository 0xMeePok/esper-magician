## firmware/main/Kconfig.projbuild
```kconfig
menu "ESPER screen"

    choice ESPER_BOARD
        prompt "ESP32 board the screen is wired to"
        default ESPER_BOARD_DEVKIT_38
        help
            The pins for the screen's backlight (BLK) and the button differ
            between boards. Pick the one you wired; firmware/README.md has both
            wirings.

        config ESPER_BOARD_DEVKIT_38
            bool "ESP32 DevKit 38-pin (BLK on GPIO 32, button on GPIO 33)"

        config ESPER_BOARD_DEVKIT_30
            bool "ESP32 DevKit 30-pin USB-C (BLK on GPIO 17, button on GPIO 16)"
    endchoice

    config ESPER_SCREEN_PIXEL_CLOCK_MHZ
        int "SPI clock for the screen (MHz)"
        range 10 80
        default 40
        help
            40 MHz works on most screens. Drop to 20 if the picture is
            noisy or garbled.

    config ESPER_SCREEN_BGR
        bool "Screen uses BGR colour order"
        default n
        help
            Flip this if the red and blue bars on the test card are swapped.

    config ESPER_SCREEN_INVERT_COLORS
        bool "Invert colours"
        default y
        help
            Flip this if the picture looks like a photo negative. Most
            1.9-inch IPS screens need it on.

    config ESPER_SCREEN_MIRROR_X
        bool "Mirror the picture left to right"
        default n

    config ESPER_SCREEN_MIRROR_Y
        bool "Mirror the picture top to bottom"
        default n

endmenu
```
